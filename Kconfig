## Kconfig
```kconfig
source "arch/Kconfig"

menu "Compile-time checks and compiler options"

config DEBUG
	bool "Debug compile option"
	default y

config GCC_V
	bool "GCC option v"
	default n

endmenu

menu "VM configuration"

config NR_VMS
	int "Number of Virtual Machines(or Guest OS)"
	default 1
	range 1 256

config VA_START
	hex "Virtual address of guest OS"
	default 0x00000000

endmenu

menu "Timer/Scheduler options"

config SCHED_RM_REPORT
	bool "Enable rate monotonic policy report printing"
	default n

config SCHED_EDF_REPORT
	bool "Enable earlist deadline first policy report printing"
	default n

config SCHED_STOPWATCH
	bool "Enable timing scheduler routine"
	default n

config TIMER_IRQ_STOPWATCH
	bool "Enable timing timer IRQ routine"
	default n

config TIMER_DEBUG
	bool "Enable printing timer debug info"
	default n

config TIMER_ACCESS_TRAP
	bool "Enable vTimer, catch timer accesses from guest"
	default y

config VTIMER_PERIODIC
	bool "Use vTimer periodic mode"
	default n

endmenu
```

## arch/Kconfig
```kconfig
choice
	prompt "Architecture select"
	default ARM

config ARM
	bool "ARM architecture"

endchoice	# Architecture select

source "arch/arm/Kconfig"
```

## arch/arm/Kconfig
```kconfig
source "core/Kconfig"

menu "ARM architecture"
	depends on ARM

config ARMV7_VIRT
	bool

config CPU_A7
	bool

config CPU_A15
	bool

choice
	prompt "Target select"

config ARCH_VERSATILE
	bool "ARM Ltd. Versatile family"
	select ARMV7_VIRT
	select CPU_A15
	select PL01X_SERIAL
	select VDEV_SAMPLE
	select VDEV_SP804
	select VDEV_SYSREG
	select VDEV_PL01X_SERIAL

config RMOBILE
	bool "Renesas ARM SoCs"
	select ARMV7_VIRT
	select CPU_A15
	select SH_SERIAL

config ARCH_EXYNOS
	bool "Samsung EXYNOS"
	select ARMV7_VIRT
	select CPU_A15
	select S5P_SERIAL
	select MCT

config ARCH_SUNXI
	bool "Allwinner SUNXI SoCs"
	select ARMV7_VIRT
	select CPU_A15
	select NS16550_SERIAL

endchoice

source "platform/Kconfig"

menuconfig ARM_PSCI
    bool "Support for ARM PSCI"

if ARM_PSCI

choice
    prompt "ARM PSCI version"

config ARM_PSCI_VERSION_0_1
    bool "ARM PSCI version 0.1"

config ARM_PSCI_VERSION_1_0
    bool "ARM PSCI version 1.0"

config ARM_PSCI_VERSION_1_1
    bool "ARM PSCI version 1.1"

endchoice

config ARM_PSCI_FN_BASE
    hex "ARM PSCI base function id"
    default 0x84000000 if ARM_PSCI_VERSION_1_0 || ARM_PSCI_VERSION_1_1

endif

menuconfig OPTEE
    bool "Support for OP-TEE Trusted OS"

if OPTEE

config NR_OPTEE_THREAD
    int "Number of OP-TEE threads"
    default 8
    range 1 256

endif

endmenu
```

## configs/bananapi_defconfig
```kconfig
CONFIG_ARM=y
CONFIG_ARCH_SUNXI=y
CONFIG_CPU_A15=y

CONFIG_ARM_PSCI=y
CONFIG_ARM_PSCI_VERSION_0_1=y
CONFIG_ARM_PSCI_BASE=0x95c1ba5e

CONFIG_SMP=y

CONFIG_NS16550_SERIAL=y

CONFIG_DEBUG=y

CONFIG_VA_START=0x48000000
```

## configs/lager_defconfig
```kconfig
CONFIG_ARM=y
CONFIG_RMOBILE=y
CONFIG_CPU_A15=y

CONFIG_SMP=y

CONFIG_SH_SERIAL=y

CONIFG_DEBUG=y
```

## configs/odroidxu_defconfig
```kconfig
CONFIG_ARM=y
CONFIG_ARCH_EXYNOS=y
CONFIG_CPU_A15=y

CONFIG_MCT=y
CONFIG_S5P_SERIAL=y

CONFIG_DEBUG=y

CONFIG_SMP=y
```

## configs/rtsm_defconfig
```kconfig
CONFIG_ARM=y
CONFIG_ARCH_VERSATILE=y
CONFIG_CPU_A15=y

CONFIG_SMP=y
CONFIG_ATAGS=y

CONFIG_PL01X_SERIAL=y
CONFIG_VDEV_SAMPLE=y
CONFIG_VDEV_SP804=y
CONFIG_VDEV_SYSREG=y

CONFIG_DEBUG=y
```

## drivers/Kconfig
```kconfig
source "drivers/serial/Kconfig"
source "drivers/vdev/Kconfig"

menu "Device Drivers"

config MCT
	bool

menuconfig DMA_ENGINE
    bool "DMA Engine support"

if DMA_ENGINE

config SUN4I_DMA
    bool "Support for sun4i DMA controller"
    depends on ARCH_SUNXI
    default ARCH_SUNXI

endif

endmenu
```

## drivers/serial/Kconfig
```kconfig
config PL01X_SERIAL
	bool

config SH_SERIAL
	bool

config S5P_SERIAL
	bool

config NS16550_SERIAL
	bool
```

## drivers/vdev/Kconfig
```kconfig
config VDEV_SAMPLE
	bool

config VDEV_SP804
	bool

config VDEV_SYSREG
	bool

config VDEV_PL01X_SERIAL
	bool
```

## platform/Kconfig
```kconfig
config ARCH_NAME
	string
	default "armv7-a" if ARMV7_VIRT

config CPU_NAME
	string
	default "cortex-a15" if CPU_A15

config TARGET_NAME
	string
	default "rtsm" if ARCH_VERSATILE
	default "lager"  if RMOBILE
	default "odroidxu" if ARCH_EXYNOS
```

## scripts/defconfig
```kconfig
#
# Example Menuconfig
#
CONFIG_String_Example="abcdef"
CONFIG_INT_Example=0
CONFIG_Bool_1_Example=y
# CONFIG_Bool_2_Example is not set
CONFIG_Depend_1_example=y
CONFIG_Depend_2_example=y
CONFIG_OPTION_1=y
# CONFIG_OPTION_2 is not set
# CONFIG_OPTION_3 is not set

#
# Applets
#
```
